#include "common.dtsi"

NOSHIFT(_ns_left, LEFT)  // LEFT arror even with SHIFT
NOSHIFT(_ns_apos, APOS)  // APOS even with SHIFT

// double quotes, cursor inside
ZMK_MACRO(_dquotes, bindings = <&kp DQT &kp DQT &_ns_left>; )
ZMK_MACRO(_squotes, bindings = <&kp APOS &kp APOS &_ns_left>; )
ZMK_MACRO(_brcs, bindings = <&kp LBRC &kp RBRC &_ns_left>; )
ZMK_MACRO(_parens, bindings = <&kp LPAR &kp RPAR &_ns_left>; )
ZMK_MACRO(_bkts, bindings = <&kp LBKT &kp RBKT &_ns_left>; )
ZMK_MACRO(_angles, bindings = <&kp LT &kp GT &_ns_left>; )

// flip SQT and DQT
ZMK_TAP_DANCE(_td_squotes, bindings = <&_ns_apos>, <&_squotes>; )     // APOS, single quotes if tapped
ZMK_TAP_DANCE(_td_dquotes, bindings = <&kp DQT>, <&_dquotes>; )       // DQT, double quotes if tapped
ZMK_MOD_MORPH(quotes,
    bindings = <&_td_dquotes>, <&_td_squotes>;
    mods = <(MOD_LSFT|MOD_RSFT)>;
)

// Tap ',' for '<>'
ZMK_TAP_DANCE(comma, bindings = <&kp COMMA>, <&_angles>; )

// Tap ( for ()
ZMK_TAP_DANCE(_td_parens, bindings = <&kp LPAR>, <&_parens>; )
ZMK_MOD_MORPH(n9,
    bindings = <&_td_parens>, <&fl_9>;
    mods = <(MOD_LSFT|MOD_RSFT)>;
)

ZMK_TAP_DANCE(_td_bkts, bindings = <&kp LBKT>, <&_bkts>; ) // Tap '[' for '[]'
ZMK_TAP_DANCE(_td_brcs, bindings = <&kp LBRC>, <&_brcs>; ) // Tap '{' for '{}'
ZMK_MOD_MORPH(lbkt,
    bindings = <&_td_bkts>, <&_td_brcs>;
    mods = <(MOD_LSFT|MOD_RSFT)>;
)
